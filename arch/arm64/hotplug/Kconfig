## arch/arm64/hotplug/Kconfig
```kconfig
config MSM_HOTPLUG
	bool "MSM hotplug driver"
	depends on HOTPLUG_CPU
	default y
	help
	  The MSM hotplug driver controls on-/offlining of additional cores based on current cpu load.

config MAKO_HOTPLUG
 	bool "Mako Hotplug"
 	default n
 	help
 	  Mako Hotplug: A custom hotplug by fransico franco

config INTELLI_PLUG
 	bool "Hotplug for Razor Reborn"
 	depends on MSM_RUN_QUEUE_STATS
 	default y
 	help
 	  This enables kernel based multi core control.

config MSM_SLEEPER
	bool "CPU hotplug driver"
	default y
	help
	  CPU hotplug driver
```
